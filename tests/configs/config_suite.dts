/dts-v1/;
/ {
    platform = "qemu-aarch64-virt";
    echo = "full";  // fulll, tf, none

    test_config {
        recipe_test {
            nix_file = "default.nix";
            suites = "HELLO";
            tests = "";
            log_level = "2"; //0, 1, 2
        };
    };
};
